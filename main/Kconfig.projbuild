## main/Kconfig.projbuild
```kconfig
menu "Example Configuration"

    config ESP_WIFI_SSID
        string "WiFi SSID"
        default "myssid"
        help
            SSID (network name) for the example to connect to.

    config ESP_WIFI_PASSWORD
        string "WiFi Password"
        default "mypassword"
        help
            WiFi password (WPA or WPA2) for the example to use.

    choice ESP_WIFI_SAE_MODE
        prompt "WPA3 SAE mode selection"
        default ESP_WPA3_SAE_PWE_BOTH
        help
            Select mode for SAE as Hunt and Peck, H2E or both.
        config ESP_WPA3_SAE_PWE_HUNT_AND_PECK
            bool "HUNT AND PECK"
        config ESP_WPA3_SAE_PWE_HASH_TO_ELEMENT
            bool "H2E"
        config ESP_WPA3_SAE_PWE_BOTH
            bool "BOTH"
    endchoice

    config ESP_WIFI_PW_ID
        string "PASSWORD IDENTIFIER"
        depends on  ESP_WPA3_SAE_PWE_HASH_TO_ELEMENT|| ESP_WPA3_SAE_PWE_BOTH
        default ""
        help
            password identifier for SAE H2E

    config ESP_MAXIMUM_RETRY
        int "Maximum retry"
        default 5
        help
            Set the Maximum retry to avoid station reconnecting to the AP unlimited when the AP is really inexistent.

    choice ESP_WIFI_SCAN_AUTH_MODE_THRESHOLD
        prompt "WiFi Scan auth mode threshold"
        default ESP_WIFI_AUTH_WPA2_PSK
        help
            The weakest authmode to accept in the scan mode.
            This value defaults to ESP_WIFI_AUTH_WPA2_PSK incase password is present and ESP_WIFI_AUTH_OPEN is used.
            Please select ESP_WIFI_AUTH_WEP/ESP_WIFI_AUTH_WPA_PSK incase AP is operating in WEP/WPA mode.

        config ESP_WIFI_AUTH_OPEN
            bool "OPEN"
        config ESP_WIFI_AUTH_WEP
            bool "WEP"
        config ESP_WIFI_AUTH_WPA_PSK
            bool "WPA PSK"
        config ESP_WIFI_AUTH_WPA2_PSK
            bool "WPA2 PSK"
        config ESP_WIFI_AUTH_WPA_WPA2_PSK
            bool "WPA/WPA2 PSK"
        config ESP_WIFI_AUTH_WPA3_PSK
            bool "WPA3 PSK"
        config ESP_WIFI_AUTH_WPA2_WPA3_PSK
            bool "WPA2/WPA3 PSK"
        config ESP_WIFI_AUTH_WAPI_PSK
            bool "WAPI PSK"
    endchoice

    config DEEPSEEK_API_KEY
        string "DeepSeek API Key"
        default "sk-xxxxxxxxxxxxxxxxxxxxxxxxxxxxxxxx"
        help
            Your DeepSeek API key from platform.deepseek.com.

    choice DEEPSEEK_MODEL
        prompt "DeepSeek Model"
        default DEEPSEEK_MODEL_V4_FLASH
        help
            Select which DeepSeek model to use for chat.

        config DEEPSEEK_MODEL_V4_FLASH
            bool "deepseek-v4-flash (fast)"
        config DEEPSEEK_MODEL_V4_PRO
            bool "deepseek-v4-pro (reasoning)"
    endchoice

    config DEEPSEEK_MODEL_STRING
        string
        default "deepseek-v4-flash" if DEEPSEEK_MODEL_V4_FLASH
        default "deepseek-v4-pro" if DEEPSEEK_MODEL_V4_PRO

    config DEEPSEEK_MAX_HISTORY
        int "Maximum chat history rounds"
        default 10
        range 1 20
        help
            Maximum number of conversation rounds to keep in memory.
            Each round includes both user input and assistant response.

    config DEEPSEEK_MAX_TOKENS
        int "Max response tokens"
        default 512
        range 64 4096
        help
            Maximum number of tokens for the model's response.

endmenu
```
